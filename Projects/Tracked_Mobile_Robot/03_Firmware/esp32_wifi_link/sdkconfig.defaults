## Projects/Tracked_Mobile_Robot/03_Firmware/esp32_wifi_link/sdkconfig.defaults
```kconfig
CONFIG_ESP_CONSOLE_UART_DEFAULT=y
CONFIG_ESP_CONSOLE_UART_BAUDRATE=115200
CONFIG_ESP_CONSOLE_SECONDARY_USB_SERIAL_JTAG=y
CONFIG_HTTPD_WS_SUPPORT=y
```
